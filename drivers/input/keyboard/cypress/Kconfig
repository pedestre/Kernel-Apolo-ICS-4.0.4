## drivers/input/keyboard/cypress/Kconfig
```kconfig
#
# Cypress touchkey configuration
#

config KEYBOARD_CYPRESS_TOUCH
	tristate "Cypress touchkey support for SAMMY ROMs"
	help
	  Say Y here to enable the cypress touchkey for sammy roms.

config TOUCHKEY_BLN
	bool "For SAMMY ROMs - with BLN support"
	depends on KEYBOARD_CYPRESS_TOUCH || KEYBOARD_CYPRESS_AOSP
	help
	  Samsung ROMs BLN support.
```
